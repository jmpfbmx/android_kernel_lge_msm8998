## drivers/input/touchscreen/lge/lgsic/Kconfig
```kconfig
#
# LGE touch core configuration
#
if INPUT_TOUCHSCREEN

menuconfig LGE_TOUCH_LGSIC_SW49410
        bool "LGE Touch Core ODM Device Driver - SW49410"
        depends on LGE_TOUCH_CORE_BASE
        help
          If your device is sw49410, say Y

menuconfig LGE_TOUCH_LPWG_RELATED_FUNC_ON
        bool "LGE LPWG"
        depends on LGE_TOUCH_LGSIC_SW49410
        help
          If your device use LPWG, say Y

# To Do : LGSIC Chipseet
endif
```
